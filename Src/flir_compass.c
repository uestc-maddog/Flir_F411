/*-----------------------------------------------------------------
 * Name:      flir_compass.c
 * Purpose:   
 *-----------------------------------------------------------------
 * 
 * Copyright (c) *reserve
 
||                       _      _               ||
||    /\  /\  __  _  __ | | __ | | ____  ___ _  ||
||   /  \/  \/ _ ` |/ _ ` |/ _ ` |/ _  \/ _ ` | ||
||  / /\  /\  (_|    (_|    (_|    (_)   (_)  | ||
|| /_/  \/  \_.__, |\__, _|\__, _|\____/\___. | ||
|| =====================================|____/  ||
||                                              ||

 -----------------------------------------------------------------*/
 
/********************************************************************************************************
 *                                               INCLUDES
 ********************************************************************************************************/
/* System ralted */
#include "stm32f4xx_hal.h"
#include <string.h> 	
#include "stdint.h"
#include <stdbool.h>
#include <math.h>

/* Special requirement */
#include "flir_compass.h"
#include "flir_lcd.h"
#include "lepton.h"
//#include "font.h"  

#define	HMC5883L_Addr   0x3C	//磁场传感器器件地址
#define COMM_TIMEOUT_MS             (1)

unsigned char BUF[8];                         //接收数据缓存区 
unsigned char sendBUF[8];                         //send数据缓存区 
int   x,y,z;
float angle,anglexz,angleyz;
extern I2C_HandleTypeDef hi2c1;
/********************************************************************************************************
 *                                                 MACROS
 ********************************************************************************************************/

/********************************************************************************************************
 *                                               CONSTANTS
 ********************************************************************************************************/
const uint8_t Compass_Data[] = { 0, 0, 0, 0, 0, 0, 0, 0, 0, 48, 3, 240, 15, 0, 15, 128, 
1, 240, 0, 112, 7, 224, 14, 0, 15, 224, 0, 240, 0, 0, 0, 0, 0, 0, 0, 0, 255, 0, 255, 0, 0, 
0, 0, 0, 0, 0, 0, 0, 0, 0, 0, 0, 0, 0, 255, 0, 255, 0, 0, 0, 0, 0, 0, 0, 0, 0, 0, 0, 0, 0, 
0, 0, 255, 0, 255, 0, 0, 0, 0, 0, 0, 0, 0, 0, 0, 0, 0, 0, 0, 0, 255, 0, 255, 0, 0, 0, 0, 0,
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0, 255, 0, 0, 0, 0, 0, 0, 0, 0, 0, 0, 0, 0, 0};
 
/********************************************************************************************************
 *                                               GLOBAL VARIABLES
 ********************************************************************************************************/


/********************************************************************************************************
 *                                               EXTERNAL VARIABLES
 ********************************************************************************************************/

 
/********************************************************************************************************
 *                                               EXTERNAL FUNCTIONS
 ********************************************************************************************************/


/********************************************************************************************************
 *                                               LOCAL VARIABLES
 ********************************************************************************************************/

 
/********************************************************************************************************
 *                                               LOCAL FUNCTIONS
 ********************************************************************************************************/

 
/********************************************************************************************************
 *                                               PUBLIC FUNCTIONS
 ********************************************************************************************************/
/*********************************************************************
 * @fn      Show_focusing
 *
 * @brief   show focusing lines
 *
 * @param   none
 *
 * @return  
 */
void Add_compass(uint16_t Compass_Angle)
{
	int i = 0, j = 0;
	uint8_t temp = 0;
	uint8_t Compass_Offset = (uint8_t)(Compass_Angle * 220 / 360);
	
	for(i = 0; i < FLIR_LCD_RAW; i++)            // 行切换
	{
		for(j = 0; j < 8; j++)                     // 前八列
		{
				temp = Compass_Data[(i+Compass_Offset)*2] << j;
				rowBuf[i][j] = (temp & 0x80)?(~rowBuf[i][j]):rowBuf[i][j];
//				if(temp & 0x80) rowBuf[i][j] = ~rowBuf[i][j];  //0x0ffff;
//				else            rowBuf[i][j] = rowBuf[i][j];					
		}
		for(j = 8; j < Compass_COLUMNUM; j++)      // 后八列
		{
				temp = Compass_Data[(i+Compass_Offset)*2+1] << (j-8);
				rowBuf[i][j] = (temp & 0x80)?(~rowBuf[i][j]):rowBuf[i][j];
//				if(temp & 0x80) rowBuf[i][j] = ~rowBuf[i][j];  //0x0ffff;
//				else            rowBuf[i][j] = rowBuf[i][j];
		}
	}
}
 


//****************************
 void  Init_HMC5883L()
{
		sendBUF[0] = 0x14;
    HAL_I2C_Mem_Write(&hi2c1,HMC5883L_Addr,0x00,I2C_MEMADD_SIZE_8BIT,sendBUF,1,COMM_TIMEOUT_MS);  
		sendBUF[0] = 0x00;
		HAL_I2C_Mem_Write(&hi2c1,HMC5883L_Addr,0x02,I2C_MEMADD_SIZE_8BIT,sendBUF,1,COMM_TIMEOUT_MS);
}
//*****************************************


void read_hmc5883l(void)
{
		sendBUF[0] = 0x14;
    HAL_I2C_Mem_Write(&hi2c1,HMC5883L_Addr,0x00,I2C_MEMADD_SIZE_8BIT,sendBUF,1,COMM_TIMEOUT_MS);  
		sendBUF[1] = 0x00;
		HAL_I2C_Mem_Write(&hi2c1,HMC5883L_Addr,0x02,I2C_MEMADD_SIZE_8BIT,&sendBUF[1],1,COMM_TIMEOUT_MS);
	//	HAL_Delay(5);

	
			HAL_I2C_Mem_Read(&hi2c1,HMC5883L_Addr,0x03,I2C_MEMADD_SIZE_8BIT,&BUF[1],6,COMM_TIMEOUT_MS);
//		HAL_I2C_Mem_Read(&hi2c1,HMC5883L_Addr,0x04,I2C_MEMADD_SIZE_8BIT,&BUF[2],1,COMM_TIMEOUT_MS);
//		HAL_I2C_Mem_Read(&hi2c1,HMC5883L_Addr,0x05,I2C_MEMADD_SIZE_8BIT,&BUF[3],1,COMM_TIMEOUT_MS);
//		HAL_I2C_Mem_Read(&hi2c1,HMC5883L_Addr,0x06,I2C_MEMADD_SIZE_8BIT,&BUF[4],1,COMM_TIMEOUT_MS);
//		HAL_I2C_Mem_Read(&hi2c1,HMC5883L_Addr,0x07,I2C_MEMADD_SIZE_8BIT,&BUF[5],1,COMM_TIMEOUT_MS);
//		HAL_I2C_Mem_Read(&hi2c1,HMC5883L_Addr,0x08,I2C_MEMADD_SIZE_8BIT,&BUF[6],1,COMM_TIMEOUT_MS);

       x=(BUF[1] << 8) | BUF[2]; //Combine MSB and LSB of X Data output register
       z=(BUF[3] << 8) | BUF[4]; //Combine MSB and LSB of Z Data output register
	     y=(BUF[5] << 8) | BUF[6]; //Combine MSB and LSB of y Data output register

       if(x>0x7fff)x-=0xffff;	  
       if(y>0x7fff)y-=0xffff;
			 if(z>0x7fff)z-=0xffff;	  	
       angle = atan2(z,y) * (180 / 3.14159265) + 180; // angle in degrees
}


  /*
********************************************************************************
** 函数名称 ： main(void)
** 函数功能 ： 主函数
** 输    入	： 无
** 输    出	： 无
** 返    回	： 无
********************************************************************************
*/

float hmc_measure()
{
	float a=0;
  uint8_t k;
	read_hmc5883l();
	a=angle;
	return a;
}

 /********************************************************************************************************
 *                                               LOCAL FUNCTIONS
 ********************************************************************************************************/


/*********************************************************************
 */
